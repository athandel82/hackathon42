AUTOSAR XML (schema 4.0)
standard types defined: boolean
package /Demo/Door
  application sw component type Door
    provide port Status: provided-interface=DoorStatus
package /Demo/Interfaces
  sender receiver interface DoorStatus
    data Locked: type=boolean
